## admin/zabbix/Config.in
```kconfig
menu "Advanced configuration"
	depends on PACKAGE_asterisk15

config ZABBIX_USE_TLS
	bool "Optimize Asterisk 15 for low memory usage"
	default n
	help
	  Warning: this feature is known to cause problems with some modules.
	  Disable it if you experience problems like segmentation faults.

endmenu
```
